AUTOSAR XML (schema 4-0-3)
package /DaVinci_Project
  module config Rte
    6 x RteBswModuleInstance:
      BswM
        BswM_MainFunctionTimingEvent0 (RteBswEventToTaskMapping): RteBswUsedOsAlarmRef=Os/Rte_Al_TE2_OsTask_BSW_0_10ms
      Det
      Dio
      EcuM
        EcuM_MainFunctionTimingEvent0 (RteBswEventToTaskMapping): RteBswUsedOsAlarmRef=Os/Rte_Al_TE2_OsTask_BSW_0_10ms
      Mcu
      Port
    5 x RteSwComponentInstance:
      BswM_EcuSwComposition
        Timer_BswM_MainFunction (RteEventToTaskMapping): RteUsedOsAlarmRef=Os/Rte_Al_TE2_OsTask_BSW_0_10ms
      CpLedTask_EcuSwComposition
        TMT_LedRunnable (RteEventToTaskMapping): RteUsedOsEventRef=Rte_Ev_Run_CpLedTask_LedRunnable, RteUsedOsAlarmRef=Os/Rte_Al_TE_CpLedTask_LedRunnable
      Det_EcuSwComposition
      EcuM_EcuSwComposition
        Timer_EcuM_MainFunction (RteEventToTaskMapping): RteUsedOsAlarmRef=Os/Rte_Al_TE2_OsTask_BSW_0_10ms
      Os_OsCore0_swc_EcuSwComposition
    RteOsInteraction
      Rte_Al_TE_CpLedTask_LedRunnable (RteUsedOsActivation): RteExpectedActivationOffset=0, RteActivationOsAlarmRef=Os/Rte_Al_TE_CpLedTask_LedRunnable, RteActivationOsTaskRef=OsTask_APP
      Rte_Al_TE2_OsTask_BSW_0_10ms (RteUsedOsActivation): RteExpectedActivationOffset=0, RteActivationOsAlarmRef=Os/Rte_Al_TE2_OsTask_BSW_0_10ms, RteActivationOsTaskRef=OsTask_BSW
  module config NvM
  module config Os
    OsTask_APP (OsTask): OsTaskActivation=1, OsTaskPriority=15, OsTaskSchedule=FULL, OsTaskEventRef=Rte_Ev_Run_CpLedTask_LedRunnable
    Rte_Al_TE_CpLedTask_LedRunnable (OsAlarm): OsAlarmCounterRef=SystemTimer
      OsAlarmAction
        OsAlarmSetEvent: OsAlarmSetEventRef=Rte_Ev_Run_CpLedTask_LedRunnable, OsAlarmSetEventTaskRef=OsTask_APP
    OsTask_BSW (OsTask): OsTaskActivation=1, OsTaskPriority=10, OsTaskSchedule=NON
    Rte_Al_TE2_OsTask_BSW_0_10ms (OsAlarm): OsAlarmCounterRef=SystemTimer
      OsAlarmAction
        OsAlarmActivateTask: OsAlarmActivateTaskRef=OsTask_BSW
    Rte_Ev_Run_CpLedTask_LedRunnable (OsEvent)
  module config EcuC
  ecuc value collection DaVinci_Project: ecuc-values=[Com, Rte, Os, EcuC, NvM]
