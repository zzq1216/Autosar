AUTOSAR XML (schema 00044)
package /ComponentTypes
  application sw component type CP_
    behavior CP__InternalBehavior
      init event CP__InitEvent: start-on-event=CP__Init
      runnable Runnable
      runnable CP__Init
  swc implementation CP__Implementation: behavior=CP__InternalBehavior
