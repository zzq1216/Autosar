AUTOSAR XML (schema 00044)
package /ComponentTypes
  application sw component type CtLedTask
    behavior CtLedTask_InternalBehavior
      timing event TMT_LedRunnable: start-on-event=LedRunnable, period=0.3
      init event CtLedTask_InitEvent: start-on-event=CtLedTask_InitRunnable
      runnable LedRunnable
      runnable CtLedTask_InitRunnable
  swc implementation CtLedTask_Implementation: behavior=CtLedTask_InternalBehavior
