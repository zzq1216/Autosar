AUTOSAR XML (schema 00044)
package /ECUCompositionTypes
  composition sw component type ECU_Composition
    component CpLedTask: type=CtLedTask
package /EndToEndProtections
  end to end protection set EndToEndProtectionSet
package /Systems
  system S32K144
    root-software-compositions:
      root sw composition prototype EcuSwComposition: software-composition=ECU_Composition
