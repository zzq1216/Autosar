AUTOSAR XML (schema 00045)
package /ActiveEcuC
  ecuc value collection ActiveEcuC: ecu-extract=SYSTEM, ecuc-values=[vSet, Det, EcuM, Os, Rte, EcuC, BswM, Base, Port, Dio, Resource, Mcu]
