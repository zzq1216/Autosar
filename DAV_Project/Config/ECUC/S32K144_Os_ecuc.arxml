AUTOSAR XML (schema 00045)
package /ActiveEcuC
  module config Os: implementation-config-variant=VARIANT-PRE-COMPILE, module-description=Os_Impl
    SystemTimer (OsCounter):
      OsCounterMaxAllowedValue = 2147483647
      OsCounterMinCycle = 1
      OsCounterType = HARDWARE
      OsSecondsPerTick = 0.001
      OsCounterTicksPerBase = 80000
      OsCounterAccessingApplication = SystemApplication_OsCore0
      OsDriver: OsDriverHighResolution=false, OsDriverIsrRef=CounterIsr_SystemTimer, OsDriverHardwareTimerChannelRef=SysTick_Ch0
    OsOS:
      OsScalabilityClass = SC1
      OsGenerateMemMapForNearAddressing = false
      OsStackMonitoring = true
      OsStatus = EXTENDED
      OsUseGetServiceId = false
      OsUseParameterAccess = false
      OsUseResScheduler = false
      OsForcibleTermination = true
      OsGenerateCalloutStubs = true
      OsGenerateMemMap = COMPLETE
      OsGenerateMemMapForThreads = false
      OsServiceProtection = false
      OsStackUsageMeasurement = false
      OsUseXSignalAsyncApiCalls = false
      OsFpuUsage = NONE
      OsNumberOfCores = 1
      OsSystemTimer = SystemTimer
      OsMasterCore = OsCore0
      OsHooks: OsErrorHook=true, OsPostTaskHook=false, OsPreTaskHook=false, OsShutdownHook=false, OsStartupHook=false, OsProtectionHook=false, OsPanicHook=true
      OsStackSummary
        7 x OsStack, all with OsStackCore=OsCore0:
          OsCore0_Init: OsStackSize=1024, OsStackType=CORE_INIT_STACK, OsStackUser=OsCore0
          OsCore0_Kernel: OsStackSize=1024, OsStackType=CORE_KERNEL_STACK, OsStackUser=OsCore0
          OsCore0_Isr_Core: OsStackSize=1024, OsStackType=ISR_SHARED_CORE_STACK, OsStackUser=CounterIsr_SystemTimer
          OsCore0_Task_Prio4294967295: OsStackSize=1024, OsStackType=TASK_SHARED_PRIORITY_STACK, OsStackUser=IdleTask_OsCore0
          OsCore0_Task_Prio10: OsStackSize=2048, OsStackType=TASK_SHARED_PRIORITY_STACK, OsStackUser=OsTask_BSW, OsStackUser=OsTask_Startup
          OsCore0_Error: OsStackSize=1024, OsStackType=CORE_ERROR_STACK, OsStackUser=OsCore0
          OsTask_APP: OsStackSize=1024, OsStackType=TASK_SHARED_PRIORITY_STACK, OsStackUser=Os/OsTask_APP
    CounterIsr_SystemTimer (OsIsr):
      OsIsrInterruptPriority = 32
      OsIsrInterruptSource = 15
      OsIsrCategory = CATEGORY_2
      OsIsrInterruptType = EXTERNAL
      OsIsrStackSize = 1024
      OsIsrEnableNesting = false
      OsIsrUsesFpu = false
      OsIsrSpecialFunctionName = Os_TimerPitIsr
      OsIsrInterruptMapping = DEFAULT
    OSDEFAULTAPPMODE (OsAppMode)
    OS_APPMODE_ANY (OsAppMode)
    OsPublishedInformation: OsKernelVersion=7, OsPlatformName=Arm
      S32K148 (OsDerivativeInformation):
        OsMpuAlignment = 32
        OsStackAlignment = 32
        OsExceptionVectorTableAlignment = 0
        OsInterruptVectorTableAlignment = 128
        OsHardwareManuals = NXP/Freescale - S32K14x Series Reference Manual - Supports S32K142, S32K144, S32K146, and S32K148 Document Number: S32K14XRM - Rev. 3, 03/2017
        Core0 (OsPhysicalCore):
          OsPhysicalCoreId = 0
          OsPhysicalCoreExceptionSources = 8
          OsPhysicalCoreIsAutostart = true
          OsPhysicalCoreMasterStartAllowed = false
          OsPhysicalCorePrivelegedHwAccess = true
          OsPhysicalCoreType = Cortex-M
          OsPhysicalCoreDefaultEntrySymbol = _start
          OsPhysicalCoreStackProtectionUnit = SystemMPU0
        INTC (OsSystemIntCtrl):
          OsSystemIntCtrlMaxPrios = 224
          OsSystemIntCtrlMaxSources = 240
          OsSystemIntCtrlPrioOrder = DESC
          OsSystemIntCtrlBaseAddress = 3758153728
          OsSystemIntCtrlType = NVIC
        OsMemoryRegionDefaults_AppT (OsMemoryRegionDefaults): OsMemoryRegionDefType=APPLICATION_TRUSTED, OsMemoryRegionDefAccessRights=SUPERVISOR_RWX, OsMemoryRegionDefBusMasters=Core
        OsMemoryRegionDefaults_AppNT (OsMemoryRegionDefaults):
          OsMemoryRegionDefType = APPLICATION_NONTRUSTED
          OsMemoryRegionDefBusMasters = Core
          OsMemoryRegionDefAccessRights = USER_R
          OsMemoryRegionDefAccessRights = USER_W
        OsMemoryRegionSpecifics
          3 x OsMemoryRegionAccess:
            SUPERVISOR_RW: OsMemoryRegionAccessRights=RW, OsMemoryRegionAccessType=SUPERVISOR
            SUPERVISOR_RWX: OsMemoryRegionAccessRights=RWX, OsMemoryRegionAccessType=SUPERVISOR
            USER_W: OsMemoryRegionAccessRights=W, OsMemoryRegionAccessType=USER
          4 x OsMemoryRegionBusMaster:
            Core: OsMemoryRegionBusMasterId=0
            Debugger: OsMemoryRegionBusMasterId=1
            DMA: OsMemoryRegionBusMasterId=2
            ENET: OsMemoryRegionBusMasterId=3
          PID_ENABLE (OsMemoryRegionFlag)
          3 x OsMemoryRegionAccess:
            USER_R: OsMemoryRegionAccessRights=R, OsMemoryRegionAccessType=USER
            USER_X: OsMemoryRegionAccessRights=X, OsMemoryRegionAccessType=USER
            SUPERVISOR_RX: OsMemoryRegionAccessRights=RX, OsMemoryRegionAccessType=SUPERVISOR
        SysTick (OsHardwareTimer): OsHardwareTimerBaseAddress=3758153744, OsHardwareTimerId=0, OsHardwareTimerSize=24, OsHardwareTimerUnit=PIT, OsHardwareTimerType=SysTick
          SysTick_Ch0 (OsHardwareTimerChannel): OsHardwareTimerChannelId=0, OsHardwareTimerChannelIntSource=15, OsHardwareTimerChannelOffset=0
        SystemMPU0 (OsSystemMpu): OsSystemMpuBaseAddress=1073795072, OsSystemMpuId=0, OsSystemMpuMaxRegions=16, OsSystemMpuType=SYSTEM_MPU_NXP
        DEFAULT (OsInterruptSupportedType): OsInterruptSupportedTypeSeparateSources=false
    OsCore0 (OsCore):
      OsCoreIsAutostart = true
      OsCoreIsAutosar = true
      OsCoreEntrySymbol = Reset_Handler
      OsCorePhysicalCoreRef = Core0
      OsCoreIdleTask = IdleTask_OsCore0
      OsCoreSystemApplication = SystemApplication_OsCore0
      OsCoreEcucCoreRef = EcucCoreDefinition
      OsCoreStacks:
        OsCoreKernelStackSize = 1024
        OsCoreStartupStackSize = 1024
        OsCoreShutdownStackSize = 1024
        OsCoreErrorStackSize = 1024
        OsCoreProtectionStackSize = 1024
        OsCoreInitStackSize = 1024
    IdleTask_OsCore0 (OsTask):
      OsTaskActivation = 1
      OsTaskPriority = 4294967295
      OsTaskSchedule = FULL
      OsTaskStackSharing = false
      OsTaskStackSize = 1024
      OsTaskType = AUTO
      OsTaskUsesFpu = false
      OsTaskAccessingApplication = SystemApplication_OsCore0
      OsTaskAutostart: OsTaskAppModeRef=OS_APPMODE_ANY, OsTaskAppModeRef=OSDEFAULTAPPMODE
    SystemApplication_OsCore0 (OsApplication):
      OsTrusted = true
      OsTrustedApplicationDelayTimingViolationCall = false
      OsTrustedApplicationWithProtection = false
      OsApplicationIsPrivileged = true
      OsAppUseTrustedFunctionStubs = false
      OsAppIsrRef = CounterIsr_SystemTimer
      OsAppCounterRef = SystemTimer
      OsAppTaskRef = IdleTask_OsCore0
      OsApplicationCoreRef = EcucCoreDefinition
      OsAppTaskRef = OsTask_BSW
      OsAppTaskRef = OsTask_Startup
      OsAppAlarmRef = Rte_Al_TE2_OsTask_BSW_0_10ms
      OsAppTaskRef = Os/OsTask_APP
      OsAppAlarmRef = Rte_Al_TE_CpLedTask_LedRunnable
      OsApplicationHooks: OsAppErrorHook=false, OsAppShutdownHook=false, OsAppStartupHook=false
    OsTask_BSW (OsTask):
      OsTaskActivation = 1
      OsTaskPriority = 10
      OsTaskSchedule = NON
      OsTaskStackSharing = false
      OsTaskStackSize = 2048
      OsTaskType = AUTO
      OsTaskUsesFpu = false
      OsTaskAccessingApplication = SystemApplication_OsCore0
      OsTaskResourceRef = OsResource
    OsTask_Startup (OsTask):
      OsTaskActivation = 1
      OsTaskPriority = 10
      OsTaskSchedule = NON
      OsTaskStackSharing = false
      OsTaskStackSize = 1024
      OsTaskType = BASIC
      OsTaskUsesFpu = false
      OsTaskAccessingApplication = SystemApplication_OsCore0
      OsTaskAutostart: OsTaskAppModeRef=OSDEFAULTAPPMODE
    OsResource: OsResourceProperty=STANDARD, OsResourceAccessingApplication=SystemApplication_OsCore0
    Rte_Al_TE2_OsTask_BSW_0_10ms (OsAlarm): OsAlarmCounterRef=SystemTimer, OsAlarmAccessingApplication=SystemApplication_OsCore0
      OsAlarmAction
        OsAlarmActivateTask: OsAlarmActivateTaskRef=OsTask_BSW
    OsTask_APP (OsTask):
      OsTaskActivation = 1
      OsTaskPriority = 15
      OsTaskSchedule = FULL
      OsTaskStackSharing = false
      OsTaskStackSize = 1024
      OsTaskType = AUTO
      OsTaskUsesFpu = false
      OsTaskAccessingApplication = SystemApplication_OsCore0
      OsTaskEventRef = Rte_Ev_Run_CpLedTask_LedRunnable
      OsTaskEventRef = OsEvent
    Rte_Al_TE_CpLedTask_LedRunnable (OsAlarm): OsAlarmCounterRef=SystemTimer, OsAlarmAccessingApplication=SystemApplication_OsCore0
      OsAlarmAction
        OsAlarmSetEvent: OsAlarmSetEventRef=Rte_Ev_Run_CpLedTask_LedRunnable, OsAlarmSetEventTaskRef=Os/OsTask_APP
    Rte_Ev_Run_CpLedTask_LedRunnable (OsEvent)
    OsEvent
