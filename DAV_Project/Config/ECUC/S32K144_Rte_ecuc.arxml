AUTOSAR XML (schema 00045)
package /ActiveEcuC
  module config Rte: implementation-config-variant=VARIANT-PRE-COMPILE, module-description=Rte_Impl
    RteOsInteraction
      Rte_Al_TE2_OsTask_BSW_0_10ms (RteUsedOsActivation): RteExpectedActivationOffset=0, RteExpectedTickDuration=0, RteActivationOsAlarmRef=Rte_Al_TE2_OsTask_BSW_0_10ms, RteActivationOsTaskRef=OsTask_BSW
      Rte_Al_TE_CpLedTask_LedRunnable (RteUsedOsActivation):
        RteExpectedActivationOffset = 0
        RteExpectedTickDuration = 0
        RteActivationOsAlarmRef = Rte_Al_TE_CpLedTask_LedRunnable
        RteActivationOsTaskRef = OsTask_APP
    RteGeneration:
      RteGenerationMode = COMPATIBILITY_MODE
      RteIocInteractionReturnValue = RTE_IOC
      RteValueRangeCheckEnabled = false
      RteCalibrationSupport = NONE
      RteCodeVendorId = 30
      RteDevErrorDetect = false
      RteDevErrorDetectUninit = false
      RteMeasurementSupport = false
      RteOptimizationMode = MEMORY
      RteVfbTraceEnabled = false
    RteInitializationBehavior: RteInitializationStrategy=RTE_INITIALIZATION_STRATEGY_AT_DATA_DECLARATION, RteSectionInitializationPolicy=INIT
    RteBswGeneral: RteSchMVersionInfoApi=false, RteUseComShadowSignalApi=false
    Det (RteBswModuleInstance): RteBswImplementationRef=Det_Impl, RteBswModuleConfigurationRef=Det
      DET_EXCLUSIVE_AREA_0 (RteBswExclusiveAreaImpl): RteExclusiveAreaImplMechanism=ALL_INTERRUPT_BLOCKING, RteBswExclusiveAreaRef=DET_EXCLUSIVE_AREA_0
    3 x RteSwComponentInstance:
      Det_EcuSwComposition: RteSoftwareComponentInstanceRef=Det
        OpEventReportError_ReportError_DetModule_DetModuleInstance (RteEventToTaskMapping): RteImmediateRestart=false, RteEventRef=OpEventReportError_ReportError_DetModule_DetModuleInstance
        OpEventReportRuntimeError_ReportRuntimeError_DetModule_DetModuleInstance (RteEventToTaskMapping): RteImmediateRestart=false, RteEventRef=OpEventReportRuntimeError_ReportRuntimeError_DetModule_DetModuleInstance
      EcuM_EcuSwComposition: RteSoftwareComponentInstanceRef=EcuM
        8 x RteEventToTaskMapping, all with RteImmediateRestart=false:
          Timer_EcuM_MainFunction: RtePositionInTask=0, RteEventRef=Timer_EcuM_MainFunction, RteMappedToTaskRef=OsTask_BSW, RteUsedOsAlarmRef=Rte_Al_TE2_OsTask_BSW_0_10ms
          OpEventSelectShutdownTarget_SelectShutdownTarget_EcuM_ShutdownTarget: RteEventRef=OpEventSelectShutdownTarget_SelectShutdownTarget_EcuM_ShutdownTarget
          OpEventGetShutdownTarget_GetShutdownTarget_EcuM_ShutdownTarget: RteEventRef=OpEventGetShutdownTarget_GetShutdownTarget_EcuM_ShutdownTarget
          OpEventGetLastShutdownTarget_GetLastShutdownTarget_EcuM_ShutdownTarget: RteEventRef=OpEventGetLastShutdownTarget_GetLastShutdownTarget_EcuM_ShutdownTarget
          OpEventSelectShutdownCause_SelectShutdownCause_EcuM_ShutdownTarget: RteEventRef=OpEventSelectShutdownCause_SelectShutdownCause_EcuM_ShutdownTarget
          OpEventGetShutdownCause_GetShutdownCause_EcuM_ShutdownTarget: RteEventRef=OpEventGetShutdownCause_GetShutdownCause_EcuM_ShutdownTarget
          OpEventSelectBootTarget_SelectBootTarget_EcuM_BootTarget: RteEventRef=OpEventSelectBootTarget_SelectBootTarget_EcuM_BootTarget
          OpEventGetBootTarget_GetBootTarget_EcuM_BootTarget: RteEventRef=OpEventGetBootTarget_GetBootTarget_EcuM_BootTarget
      Os_OsCore0_swc_EcuSwComposition: RteSoftwareComponentInstanceRef=Os_OsCore0_swc
        OpEventGetCounterValue_GetCounterValue_OsService_SystemTimer (RteEventToTaskMapping): RteImmediateRestart=false, RteEventRef=OpEventGetCounterValue_GetCounterValue_OsService_SystemTimer
        OpEventGetElapsedValue_GetElapsedValue_OsService_SystemTimer (RteEventToTaskMapping): RteImmediateRestart=false, RteEventRef=OpEventGetElapsedValue_GetElapsedValue_OsService_SystemTimer
    3 x RteBswModuleInstance:
      EcuM: RteBswImplementationRef=EcuM_Impl, RteBswModuleConfigurationRef=EcuM
        3 x RteBswExclusiveAreaImpl, all with RteExclusiveAreaImplMechanism=ALL_INTERRUPT_BLOCKING:
          ECUM_EXCLUSIVE_AREA_{0..2}: RteBswExclusiveAreaRef=ECUM_EXCLUSIVE_AREA_{0..2}
        EcuM_MainFunctionTimingEvent0 (RteBswEventToTaskMapping):
          RteBswImmediateRestart = false
          RteBswPositionInTask = 0
          RteBswEventRef = EcuM_MainFunctionTimingEvent0
          RteBswMappedToTaskRef = OsTask_BSW
          RteBswUsedOsAlarmRef = Rte_Al_TE2_OsTask_BSW_0_10ms
      Rte: RteBswImplementationRef=Rte_Impl, RteBswModuleConfigurationRef=Rte
      BswM: RteBswImplementationRef=BswM_Impl, RteBswModuleConfigurationRef=BswM
        BswM_MainFunctionTimingEvent0 (RteBswEventToTaskMapping):
          RteBswImmediateRestart = false
          RteBswPositionInTask = 1
          RteBswEventRef = BswM_MainFunctionTimingEvent0
          RteBswMappedToTaskRef = OsTask_BSW
          RteBswUsedOsAlarmRef = Rte_Al_TE2_OsTask_BSW_0_10ms
        BSWM_EXCLUSIVE_AREA_0 (RteBswExclusiveAreaImpl): RteExclusiveAreaImplMechanism=ALL_INTERRUPT_BLOCKING, RteBswExclusiveAreaRef=BSWM_EXCLUSIVE_AREA_0
    BswM_EcuSwComposition (RteSwComponentInstance): RteSoftwareComponentInstanceRef=BswM
      Timer_BswM_MainFunction (RteEventToTaskMapping):
        RteImmediateRestart = false
        RtePositionInTask = 1
        RteEventRef = Timer_BswM_MainFunction
        RteMappedToTaskRef = OsTask_BSW
        RteUsedOsAlarmRef = Rte_Al_TE2_OsTask_BSW_0_10ms
    3 x RteBswModuleInstance:
      Port: RteBswImplementationRef=Port_Impl, RteBswModuleConfigurationRef=Port
        31 x RteBswExclusiveAreaImpl, all with RteExclusiveAreaImplMechanism=ALL_INTERRUPT_BLOCKING:
          PORT_EXCLUSIVE_AREA_{00..30}: RteBswExclusiveAreaRef=PORT_EXCLUSIVE_AREA_{00..30}
      Dio: RteBswImplementationRef=Dio_Impl, RteBswModuleConfigurationRef=Dio
        31 x RteBswExclusiveAreaImpl, all with RteExclusiveAreaImplMechanism=ALL_INTERRUPT_BLOCKING:
          DIO_EXCLUSIVE_AREA_{00..30}: RteBswExclusiveAreaRef=DIO_EXCLUSIVE_AREA_{00..30}
      Mcu: RteBswImplementationRef=Mcu_Impl, RteBswModuleConfigurationRef=Mcu
        31 x RteBswExclusiveAreaImpl, all with RteExclusiveAreaImplMechanism=ALL_INTERRUPT_BLOCKING:
          MCU_EXCLUSIVE_AREA_{00..30}: RteBswExclusiveAreaRef=MCU_EXCLUSIVE_AREA_{00..30}
    CpLedTask_EcuSwComposition (RteSwComponentInstance): RteSoftwareComponentInstanceRef=CpLedTask
      CtLedTask_InitEvent (RteEventToTaskMapping): RteImmediateRestart=false, RtePositionInTask=0, RteEventRef=CtLedTask_InitEvent, RteMappedToTaskRef=OsTask_APP
      TMT_LedRunnable (RteEventToTaskMapping):
        RteImmediateRestart = false
        RtePositionInTask = 1
        RteEventRef = TMT_LedRunnable
        RteMappedToTaskRef = OsTask_APP
        RteUsedOsEventRef = Rte_Ev_Run_CpLedTask_LedRunnable
        RteUsedOsAlarmRef = Rte_Al_TE_CpLedTask_LedRunnable
    CtLedTask (RteSwComponentType): RteComponentTypeRef=CtLedTask, RteImplementationRef=CtLedTask_Implementation
      ComponentTypeCalibration (RteComponentTypeCalibration): RteCalibrationSupportEnabled=false
