AUTOSAR XML (schema 4-0-3)
package /TS_T40D2M10I1R0/Dio_ib_bswmd/BswModuleDescriptions
  bsw module description Dio
    bsw internal behavior DioBehavior
      31 x exclusive area:
        DIO_EXCLUSIVE_AREA_{00..30}
