AUTOSAR XML (schema 4-0-3)
package /TS_T40D2M10I1R0/Port_ib_bswmd/BswModuleDescriptions
  bsw module description Port
    bsw internal behavior PortBehavior
      31 x exclusive area:
        PORT_EXCLUSIVE_AREA_{00..30}
