AUTOSAR XML (schema 4-0-3)
package /COM/VECTOR/CFG/WORKFLOW/SYSDESC/SYNC
  flat map FLATMAP
    flat instance descriptor CpLedTask: upstream-reference=EcuSwComposition.CpLedTask, ecu-extract-reference=COMPOSITIONTYPE.CpLedTask
